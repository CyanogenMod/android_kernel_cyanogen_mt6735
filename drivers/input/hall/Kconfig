## drivers/input/hall/Kconfig
```kconfig
config HALL_MTK
	tristate "Eastaeon Hall Support"
	default n
	help
	  Say Y here if you have Eastaeon hall device.

	  If unsure, say Y.
```

## drivers/input/touchscreen/mediatek/Kconfig
```kconfig
#
# Touchscreen driver configuration
#
menuconfig INPUT_TOUCHSCREEN
	bool "Touchscreens"
	help
	  Say Y here, and a list of supported touchscreens will be displayed.
	  This option doesn't affect the kernel.

	  If unsure, say Y.

if INPUT_TOUCHSCREEN

config TOUCHSCREEN_MTK
	bool "MediaTek Touch Panel Driver"
	help
	  Say Y here if you have MediaTek touch panel.

	  If unsure, say N.

	  To compile this dirver as a module, choose M here: the
	  module will be called.

config TOUCHSCREEN_MTK_GT1151
	bool "GT1151 for Mediatek package"
	default n
	help
	  Say Y here if you have GT1151 touch panel.

	  If unsure, say N.

	  To compile this dirver as a module, choose M here: the
	  module will be called.

#source "drivers/input/touchscreen/mediatek/GT1151/Kconfig"

config TOUCHSCREEN_MTK_GT928
	tristate "GT928 Touchscreen"
	help
	  Say Y here if you have Goodix GT928 touchscreen,
	  connected to your system.
	  If unsure, say N.
	  To compile this driver as a module, choose M here.

config TOUCHSCREEN_MTK_GT9XXTB_HOTKNOT
	bool "GT9XXTB hotknot for Mediatek package"
	default n
	help
	  Say Y here if you have GT9xx touch panel.

	  If unsure, say N.

	  To compile this dirver as a module, choose M here: the
	  module will be called.

#source "drivers/input/touchscreen/mediatek/GT9XXTB_hotknot/Kconfig"

config TOUCHSCREEN_MTK_SYNAPTICS_I2C_RMI4
	tristate "Synaptics DSX I2C touchscreen"
	depends on I2C
	help
	  Say Y here if you have a Synaptics DSX I2C touchscreen
	  connected to your system.

	  If unsure, say N.

	  To compile this driver as a module, choose M here: the
	  module will be called synaptics_i2c_rmi4.

#source "drivers/input/touchscreen/mediatek/synaptics_i2c_rmi4/Kconfig"

config TOUCHSCREEN_MTK_GT910
	bool "GT910 for Mediatek package"
	default n
	help
	  Say Y here if you have GT910 touch panel.

	  If unsure, say N.

	  To compile this dirver as a module, choose M here: the
	  module will be called.

#source "drivers/input/touchscreen/mediatek/GT910/Kconfig"

config TOUCHSCREEN_MTK_GT9XX_HOTKNOT_SCP
	bool "GT9XX_HOTKNOT_SCP for Mediatek package"
	default n
	help
	  Say Y here if you have GT9XX_HOTKNOT_SCP touch panel.

	  If unsure, say N.

	  To compile this dirver as a module, choose M here: the
	  module will be called.

#source "drivers/input/touchscreen/mediatek/GT9XX_hotknot_scp/Kconfig"

config TOUCHSCREEN_MTK_GT911
	bool "GT911 for Mediatek package"
	default n
	help
	  Say Y here if you have GT911 touch panel.

	  If unsure, say N.

	  To compile this dirver as a module, choose M here: the
	  module will be called.

#source "drivers/input/touchscreen/mediatek/GT911/Kconfig"

config TOUCHSCREEN_MTK_FT5X0X
	bool "FT5X0X for Mediatek package"
	default n
	help
	  Say Y here if you have FT5X0X touch panel.

	  If unsure, say N.

	  To compile this dirver as a module, choose M here: the
	  module will be called.

#source "drivers/input/touchscreen/mediatek/ft5x0x/Kconfig"

config TOUCHSCREEN_AEON_GT1X
	bool "GT1X for Eastaeon package"
	default n
	help
	  Say Y here if you have GT1X touch panel.

	  If unsure, say N.

	  To compile this dirver as a module, choose M here: the
	  module will be called.

config TOUCHSCREEN_AEON_GT9XX
	bool "GT9XX for Eastaeon package"
	default n
	help
	  Say Y here if you have GT9XX touch panel.

	  If unsure, say N.

	  To compile this dirver as a module, choose M here: the
	  module will be called.

config TOUCHSCREEN_AEON_SYNAPTICS_S2714
	bool "SYNAPTICS_S2714 for Eastaeon package"
	default n
	help
	  Say Y here if you have synaptics_s2714 touch panel.

	  If unsure, say N.

	  To compile this dirver as a module, choose M here: the
	  module will be called.

config TOUCHSCREEN_AEON_FACTORY_CTP
	bool "aeon_factory_ctp for Eastaeon package"
	default n
	help
	  Say Y here if you have aeon_factory_ctp touch panel.

	  If unsure, say N.

	  To compile this dirver as a module, choose M here: the
	  module will be called.

config TOUCHSCREEN_AEON_FT5X0X
	bool "aeon_ft5x0x for Eastaeon package"
	default n
	help
	  Say Y here if you have aeon_ft5x0x touch panel.

	  If unsure, say N.

	  To compile this dirver as a module, choose M here: the
	  module will be called.

config TOUCHSCREEN_AEON_FOCALTECH
	bool "aeon_focaltech for Eastaeon package"
	default n
	help
	  Say Y here if you have aeon_focaltech touch panel.

	  If unsure, say N.

	  To compile this dirver as a module, choose M here: the
	  module will be called.


config TOUCHSCREEN_AEON_SYNAPTICS_S2714_8536
        bool "SYNAPTICS_S2714  for AEON package"
	default n
	help
	  Say Y here if you have synaptics s2714 touch panel.

	  If unsure, say N.

	  To compile this dirver as a module, choose M here: the
	  module will be called.

source "drivers/input/touchscreen/mediatek/aeon_synaptics_s2714_8536/Kconfig"

config TOUCHSCREEN_AEON_FT5X0X_8536
        bool "ft5x0x  for AEON package"
	default n
	help
	  Say Y here if you have ft5x0x touch panel.

	  If unsure, say N.

	  To compile this dirver as a module, choose M here: the
	  module will be called.

source "drivers/input/touchscreen/mediatek/aeon_ft5x0x_hd720_lide_8536/Kconfig"

config TOUCHSCREEN_MTK_AEON_NT11205_HD720_HLT_8536
	bool "aeon_nt11205_hd720_hlt_8536 for Mediatek package"
	default n
	help
	  Say Y here if you have aeon_nt11205_hd720_hlt_8536 touch panel.

	  If unsure, say N.

	  To compile this dirver as a module, choose M here: the
	  module will be called.

source "drivers/input/touchscreen/mediatek/aeon_nt11205_hd720_hlt_8536/Kconfig"	  

config TOUCHSCREEN_AEON_FT5X0X_8630
	bool "aeon touchscreen ft5x0x 8630 for Eastaeon package"
	default n
	help
	  Say Y here if you have aeon_ft5x0x touch panel.

	  If unsure, say N.

	  To compile this dirver as a module, choose M here: the
	  module will be called.
source "drivers/input/touchscreen/mediatek/aeon_ft5x0x_hd720_lide_8630/Kconfig"

config TOUCHSCREEN_AEON_MSTAR_8630
	bool "aeon_mstar_8630_v3.14 for Eastaeon package"
	default n
	help
	  Say Y here if you have mstar touch panel.

	  If unsure, say N.

	  To compile this dirver as a module, choose M here: the
	  module will be called.


endif
```

## drivers/misc/mediatek/accelerometer/aeon_mc3410-new/Kconfig
```kconfig
config AEON_MC3410_NEW
	bool "aeon MC3410 for MediaTek package"
	default n
	help
	  It support different accelerometer sensor.
          If this option is set,
	  it will support
          MC3410 Accelerometer.
```

## drivers/misc/mediatek/accelerometer/kx023-new/Kconfig
```kconfig
config MTK_KX023_NEW
	bool "KX023 for MediaTek package"
	default n
	help
	  It support different accelerometer sensor.
          If this option is set,
	  it will support
          KX023 Accelerometer.
```

## drivers/misc/mediatek/magnetometer/af7133-new/Kconfig
```kconfig
config MTK_AF7133_NEW
	bool "AF7133 for MediaTek package"
	default n
	help
	  It support different magnetometer sensor.
          If this option is set,
	  it will support
          AF7133 magnetometer.
```

## drivers/misc/mediatek/magnetometer/af8133-new/Kconfig
```kconfig
config MTK_AF8133_NEW
	bool "AF8133 for MediaTek package"
	default n
	help
	  It support different magnetometer sensor.
          If this option is set,
	  it will support
          AF8133 magnetometer
```
